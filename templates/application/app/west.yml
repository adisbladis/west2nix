## templates/application/app/west.yml
```yaml
manifest:

  remotes:
    - name: zephyrproject-rtos
      url-base: https://github.com/zephyrproject-rtos

  projects:
    - name: zephyr
      remote: zephyrproject-rtos
      repo-path: zephyr
      revision: main
      clone-depth: 1
      import:
        name-allowlist:
          - cmsis
          - hal_nordic
```
